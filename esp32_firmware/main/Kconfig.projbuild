## esp32_firmware/main/Kconfig.projbuild
```kconfig
menu "Config"
    config WIFI_SSID
        string "WiFi SSID"
        default "your-ssid"
    
    config WIFI_PASSWORD
        string "WiFi Password"
        default "your-password"
    
    config WIFI_MAXIMUM_RETRY
        int "WiFi Maximum Retry"
        default 5
endmenu
```
